## conf/distro/zig.conf
```bitbake
require conf/distro/poky.conf

# provision defaults
DISTRO = "zig"
DISTRO_NAME = "zig distro"
DISTRO_VERSION = "1.0+snapshot-${DATE}"
DISTRO_CODENAME = "zig_alpha"

# let's roll on ipk
PACKAGE_CLASSES = "package_ipk"
```
